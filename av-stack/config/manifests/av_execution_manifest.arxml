AUTOSAR XML (schema 00050)
package /av/Exec
  mode declaration group ProcessState: initial-mode=Idle
    mode Idle
    mode Running
    mode Terminated
package /av/Processes
  6 x process:
    gateway: executable=carla_gateway
      process state machine ProcessState: type=ProcessState
      mode-dependent-startup-configs:
        {function-group-state=Init, startup-config={process-argument=--phase=init, termination-behavior=PROCESS-IS-SELF-TERMINATING}}
        {function-group-state=[Running, SafeStop], startup-config={process-argument=--phase=run, termination-behavior=PROCESS-IS-NOT-SELF-TERMINATING}}
    localization_app: executable=localization_app, number-of-restart-attempts=3
      process state machine ProcessState: type=ProcessState
      mode-dependent-startup-configs:
        {function-group-state=Init, startup-config={process-argument=--phase=init, termination-behavior=PROCESS-IS-SELF-TERMINATING}}
        {function-group-state=Running, startup-config={process-argument=--phase=run, termination-behavior=PROCESS-IS-NOT-SELF-TERMINATING}}
    perception_app: executable=perception_app
      process state machine ProcessState: type=ProcessState
      mode-dependent-startup-configs:
        {function-group-state=Init, startup-config={process-argument=--phase=init, termination-behavior=PROCESS-IS-SELF-TERMINATING}}
        {function-group-state=Running, startup-config={process-argument=--phase=run, termination-behavior=PROCESS-IS-NOT-SELF-TERMINATING}}
    planning_app: executable=planning_app
      process state machine ProcessState: type=ProcessState
      mode-dependent-startup-configs:
        {function-group-state=Init, startup-config={process-argument=--phase=init, termination-behavior=PROCESS-IS-SELF-TERMINATING}}
        {function-group-state=Running, startup-config={process-argument=--phase=run, termination-behavior=PROCESS-IS-NOT-SELF-TERMINATING}}
    control_app: executable=control_app
      process state machine ProcessState: type=ProcessState
      mode-dependent-startup-configs:
        {function-group-state=Init, startup-config={process-argument=--phase=init, termination-behavior=PROCESS-IS-SELF-TERMINATING}}
        {function-group-state=Running, startup-config={process-argument=--phase=run, scheduling-policy=SCHED-FIFO, scheduling-priority=30, termination-behavior=PROCESS-IS-NOT-SELF-TERMINATING}}
    safe_stop_app: executable=safe_stop_app, mode-dependent-startup-config{function-group-state=SafeStop, startup-config={scheduling-policy=SCHED-FIFO, scheduling-priority=40}}
