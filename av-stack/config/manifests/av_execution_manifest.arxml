AUTOSAR XML (schema 00050)
package /av/Exec
  mode declaration group ProcessState: initial-mode=Idle
    mode Idle
    mode Running
    mode Terminated
package /av/Processes
  11 x process:
    gateway_init: executable=carla_gateway, mode-dependent-startup-config{function-group-state=Init, startup-config={process-argument=--phase=init, termination-behavior=PROCESS-IS-SELF-TERMINATING}}
      process state machine ProcessState: type=ProcessState
    localization_init: executable=localization_app, mode-dependent-startup-config{function-group-state=Init, startup-config={process-argument=--phase=init, termination-behavior=PROCESS-IS-SELF-TERMINATING}}
      process state machine ProcessState: type=ProcessState
    perception_init: executable=perception_app, mode-dependent-startup-config{function-group-state=Init, startup-config={process-argument=--phase=init, termination-behavior=PROCESS-IS-SELF-TERMINATING}}
      process state machine ProcessState: type=ProcessState
    planning_init: executable=planning_app, mode-dependent-startup-config{function-group-state=Init, startup-config={process-argument=--phase=init, termination-behavior=PROCESS-IS-SELF-TERMINATING}}
      process state machine ProcessState: type=ProcessState
    control_init: executable=control_app, mode-dependent-startup-config{function-group-state=Init, startup-config={process-argument=--phase=init, termination-behavior=PROCESS-IS-SELF-TERMINATING}}
      process state machine ProcessState: type=ProcessState
    gateway_app: executable=carla_gateway, mode-dependent-startup-config{function-group-state=Running, startup-config={process-argument=--phase=run, termination-behavior=PROCESS-IS-NOT-SELF-TERMINATING}}
      process state machine ProcessState: type=ProcessState
    localization_app: executable=localization_app, mode-dependent-startup-config{function-group-state=Running, startup-config={process-argument=--phase=run, termination-behavior=PROCESS-IS-NOT-SELF-TERMINATING}}
      process state machine ProcessState: type=ProcessState
    perception_app: executable=perception_app, mode-dependent-startup-config{function-group-state=Running, startup-config={process-argument=--phase=run, termination-behavior=PROCESS-IS-NOT-SELF-TERMINATING}}
      process state machine ProcessState: type=ProcessState
    planning_app: executable=planning_app, mode-dependent-startup-config{function-group-state=Running, startup-config={process-argument=--phase=run, termination-behavior=PROCESS-IS-NOT-SELF-TERMINATING}}
      process state machine ProcessState: type=ProcessState
    control_app: executable=control_app, mode-dependent-startup-config{function-group-state=Running, startup-config={process-argument=--phase=run, scheduling-policy=SCHED-FIFO, scheduling-priority=30, termination-behavior=PROCESS-IS-NOT-SELF-TERMINATING}}
      process state machine ProcessState: type=ProcessState
    safe_stop_app: executable=safe_stop_app, mode-dependent-startup-config{function-group-state=SafeStop, startup-config={scheduling-policy=SCHED-FIFO, scheduling-priority=40}}
